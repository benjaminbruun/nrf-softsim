## CMakeLists.txt
```
# SPDX-FileCopyrightText: Copyright (c) 2023-2026 Onomondo ApS
# SPDX-License-Identifier: GPL-3.0-only

cmake_minimum_required(VERSION 3.20.0)

list(APPEND OVERLAY_CONFIG "$ENV{ZEPHYR_BASE}/../modules/lib/onomondo-softsim/overlay-softsim.conf")

find_package(Zephyr REQUIRED HINTS $ENV{ZEPHYR_BASE})
project(softsim_memfault)

# Memfault user config (trace reasons, heartbeat metrics, platform overrides)
zephyr_include_directories(config)

target_sources(app PRIVATE src/main.c)
# Battery sources are board-family-specific:
# - Thingy:91 (ADP536x): battery.c implements memfault_platform_get_stateofcharge()
# - Thingy:91 X (nPM1300): Memfault's npm13xx port implements it; fuel_gauge.c
#   owns the nrf_fuel_gauge init/process loop the port reads from
target_sources_ifdef(CONFIG_ADP536X app PRIVATE src/battery.c)
target_sources_ifdef(CONFIG_MEMFAULT_NRF_PLATFORM_BATTERY_NPM13XX app PRIVATE src/fuel_gauge.c)
```

## prj.conf
```kconfig
# --- SoftSIM profile source -------------------------------------------------
# Default: EXTERNAL - the device waits for a profile over serial on first boot,
# provisions it, then reboots.
#
# For STATIC mode, uncomment the two lines below and replace the profile string with
# your Onomondo SoftSIM profile (hex string, as printed by `./softsim next` of the SoftSIM CLI Tool).
# CONFIG_SOFTSIM_STATIC_PROFILE_ENABLE=y
# CONFIG_SOFTSIM_STATIC_PROFILE="01120809101010325476980214980010325476981032140320000000000000000000000000000000000420000102030405060708090A0B0C0D0E0F0520000102030405060708090A0B0C0D0E0F0620000102030405060708090A0B0C0D0E0F"

# Thingy:91 X and other MCUboot-serial-recovery-only targets are flashed with
# dfu_application.zip, which covers just the application slot - the bundled
# SoftSIM template partition never reaches the device. Embed the template in
# the app and seed nvs_storage on first boot so provisioning can run.
CONFIG_SOFTSIM_EMBED_TEMPLATE=y

# Configured to allow a reboot following the provisioning of a profile
CONFIG_REBOOT=y

# SoftSIM debug logging: full firehose on purpose - this is a stress/soak
# build and the point is to get as many SoftSIM logs into Memfault as possible.
# LIBS also bumps LOG_BUFFER_SIZE to 16384; expect ring wrap during SIM init.
CONFIG_SOFTSIM_NRF_DEBUG_LOGS=y
CONFIG_SOFTSIM_LIBS_DEBUG_LOGS=y

# Report onomondo-uicc SS_LOGP errors as Memfault trace events
# (reason: softsim_uicc_error, defined in config/memfault_trace_reason_user_config.def)
CONFIG_SOFTSIM_MEMFAULT_TRACE=y

# SoftSIM operation heartbeat metrics (APDU/auth counts, NVS I/O, lifecycle);
# keys defined in config/memfault_metrics_heartbeat_config.def
CONFIG_SOFTSIM_MEMFAULT_METRICS=y

# Factory reset the modem - helpful for development when the modem may be in an unknown state.
CONFIG_SOFTSIM_FACTORY_RESET_ON_PROVISION=n

# Visual activity indicator: breathe the RGB LED's green channel on each LTE
# attach attempt (see src/main.c pulse_led1()). PWM LED driver only - the
# gpio-leds driver (CONFIG_LED_GPIO) stays off, so nothing else claims the pins.
CONFIG_LED=y
CONFIG_LED_PWM=y
CONFIG_PWM=y
# The gpio-leds node is status-okay too, so LED_GPIO auto-enables and would fight
# LED_PWM for the same pins (P0.29/30/31). We drive the LED via PWM only.
CONFIG_LED_GPIO=n

# Modem Configurations
CONFIG_NRF_MODEM_LIB=y

# NET Configurations
CONFIG_NETWORKING=y
CONFIG_NET_SOCKETS=y
CONFIG_NET_NATIVE=n
CONFIG_NET_SOCKETS_OFFLOAD=y
CONFIG_POSIX_API=y

# LTE Configurations
CONFIG_LTE_LINK_CONTROL=y
# Required by MEMFAULT_NCS_POST_COREDUMP_ON_NETWORK_CONNECTED
CONFIG_LTE_LC_PDN_MODULE=y
# LTE-M only: no NB-IoT/GNSS scanning, so churn re-attach times are
# deterministic and comparable cycle-to-cycle.
CONFIG_LTE_NETWORK_MODE_LTE_M=y
# Soak intent: stay online and awake - never request PSM/eDRX (these are the
# NCS defaults, stated explicitly so a default change can't sneak them in).
CONFIG_LTE_PSM_REQ=n
CONFIG_LTE_EDRX_REQ=n

# Shell instead of the AT host used by the flagship sample - both would claim
# uart0, and the `mflt` shell commands are the test surface here. AT commands
# are still available through the `at` shell command.
CONFIG_SERIAL=y
CONFIG_UART_INTERRUPT_DRIVEN=y
CONFIG_SHELL=y
CONFIG_AT_SHELL=y

# Catch programming errors as Memfault-captured asserts instead of silent corruption
CONFIG_ASSERT=y

# --- Memfault ----------------------------------------------------------------
CONFIG_MEMFAULT=y
# Keep the key out of the public repo; inject it at build time:
#   west build ... -- -DCONFIG_MEMFAULT_NCS_PROJECT_KEY=\"<your key>\"
# An empty key fails the build on purpose (BUILD_ASSERT in the NCS integration)
# with a pointer to https://goto.memfault.com/create-key/nrf91
CONFIG_MEMFAULT_NCS_PROJECT_KEY=""

# Device ID = IMEI (MEMFAULT_NCS_DEVICE_ID_HW_ID is the default ID source)
CONFIG_HW_ID_LIBRARY_SOURCE_IMEI=y

# HTTPS upload; root CAs are provisioned to modem sec tags 1001-1005 at first boot
CONFIG_MEMFAULT_HTTP_ENABLE=y
CONFIG_MEMFAULT_PERIODIC_UPLOAD=y
CONFIG_MEMFAULT_ROOT_CERT_STORAGE_NRF_MODEM=y
CONFIG_MODEM_KEY_MGMT=y

# Metrics: LTE (time-to-connect, connection losses) and per-thread stack usage
CONFIG_MEMFAULT_NCS_LTE_METRICS=y
CONFIG_MODEM_INFO=y
CONFIG_MEMFAULT_NCS_STACK_METRICS=y

# Capture Zephyr logs in a RAM ring and upload the ring on every periodic
# pass (it wraps, so each upload carries the most-recent ~16 KB window -
# self-limiting on LTE bandwidth). Per-level log-volume metrics are free.
CONFIG_MEMFAULT_LOGGING_ENABLE=y
CONFIG_MEMFAULT_LOGGING_RAM_SIZE=16384
CONFIG_MEMFAULT_HTTP_PERIODIC_UPLOAD_LOGS=y
CONFIG_MEMFAULT_METRICS_LOGS_ENABLE=y

# Evaluation cadence: 5-min heartbeats and uploads (defaults are 3600 s)
CONFIG_MEMFAULT_METRICS_HEARTBEAT_INTERVAL_SECS=300
CONFIG_MEMFAULT_HTTP_PERIODIC_UPLOAD_INTERVAL_SECS=300

# Coredump quality: all thread stacks, .bss, heap statistics
CONFIG_MEMFAULT_COREDUMP_FULL_THREAD_STACKS=y
CONFIG_MEMFAULT_COREDUMP_COLLECT_BSS_REGIONS=y
CONFIG_MEMFAULT_HEAP_STATS=y

# Store coredumps in internal flash (Partition Manager auto-generates a
# 0x10000 MEMFAULT_STORAGE partition) and post them right after LTE attach
CONFIG_MEMFAULT_NCS_INTERNAL_FLASH_BACKED_COREDUMP=y
CONFIG_STREAM_FLASH=y
CONFIG_MEMFAULT_NCS_POST_COREDUMP_ON_NETWORK_CONNECTED=y

# `mflt` shell commands for exercising the integration (test crashes, export, post)
CONFIG_MEMFAULT_SHELL=y

# Software watchdog fed by the churn loop in main(); expiry asserts, so a hung
# loop produces a Memfault coredump + tracked reboot instead of a silent wedge.
CONFIG_MEMFAULT_SOFTWARE_WATCHDOG_TIMEOUT_SECS=120

# --- TF-M ---------------------------------------------------------------------
# Reduce the size of TF-M by disabling the PS
CONFIG_TFM_PARTITION_PROTECTED_STORAGE=n
CONFIG_PSA_CRYPTO_DRIVER_CC3XX=n

# Reduce the size of the TF-M partition
# when combined with static partitioning
CONFIG_PM_PARTITION_SIZE_TFM=0x10000

# The bootloader adds a small mcuboot_pad partition,
# whose size must be subtracted from the TF-M partition
#CONFIG_BOOTLOADER_MCUBOOT=y
#CONFIG_PM_PARTITION_SIZE_TFM=0xfe00
```

## boards/thingy91_nrf9160_ns.conf
```kconfig
# SPDX-FileCopyrightText: Copyright (c) 2026 Onomondo ApS
# SPDX-License-Identifier: GPL-3.0-only

# Report battery SoC via the Memfault battery metrics component.
# The Thingy:91 board init already enables the ADP536x fuel gauge
# (CONFIG_ADP536X defaults to y from the adi,adp5360 devicetree node).
CONFIG_MEMFAULT_METRICS_BATTERY_ENABLE=y
CONFIG_ADP536X=y
```

## boards/thingy91x_nrf9151_ns.conf
```kconfig
# SPDX-FileCopyrightText: Copyright (c) 2026 Onomondo ApS
# SPDX-License-Identifier: GPL-3.0-only

# Battery metrics from the nPM1300. This is the only switch needed: the board
# DT enables npm1300_charger (NPM13XX_CHARGER defaults y), and Memfault's
# npm13xx battery port (MEMFAULT_NRF_PLATFORM_BATTERY_NPM13XX) defaults y on
# this board once the fuel-gauge lib is in, selecting
# MEMFAULT_METRICS_BATTERY_ENABLE. App side: src/fuel_gauge.c.
CONFIG_NRF_FUEL_GAUGE=y
```

## src/main.c
```c
/*
 * SPDX-FileCopyrightText: Copyright (c) 2023-2026 Onomondo ApS
 * SPDX-License-Identifier: GPL-3.0-only
 */

#include <nrf_softsim.h>
#include <modem/lte_lc.h>
#include <modem/nrf_modem_lib.h>
#include <zephyr/kernel.h>
#include <zephyr/device.h>
#include <zephyr/drivers/led.h>
#include <zephyr/drivers/uart.h>
#include <zephyr/logging/log.h>
#include <zephyr/logging/log_ctrl.h>
#include <zephyr/sys/reboot.h>

#include <memfault/core/data_packetizer.h>
#include <memfault/core/trace_event.h>
#include <memfault/metrics/metrics.h>
#include <memfault/panics/coredump.h>
#include <memfault/ports/watchdog.h>
#include <memfault/ports/zephyr/http.h>

LOG_MODULE_REGISTER(softsim_sample, LOG_LEVEL_INF);

/* Headroom over the full SoftSIM profile (~410 chars incl. SMSP/PIN/SMSC) */
#define PROFILE_MAX_SIZE 512

/* Reconnect-churn soak cadence. Each cycle: dwell online, then force a
 * re-attach that powers the UICC off/on (CFUN=4 shuts the UICC down on nRF91,
 * so every cycle re-runs SoftSIM DEINIT -> INIT/ATR/USIM file re-reads, plus
 * network re-authentication whenever the network challenges).
 * ponytail: compile-time knobs on purpose - anyone running a soak rig is
 * already editing and rebuilding this sample; upgrade path is a sample Kconfig. */
#define DWELL_ONLINE_SEC	300 /* one heartbeat/upload period online per cycle */
#define OFFLINE_HOLD_SEC	5
#define CYCLES_PER_FULL_RESTART 10  /* deep modem-lib restart every Nth cycle */
#define CONNECT_TIMEOUT_SEC	180
#define MAX_CONNECT_FAILURES	3   /* then reboot; Memfault records the reboot reason */
#define WATCHDOG_FEED_SLICE_SEC 10  /* < CONFIG_MEMFAULT_SOFTWARE_WATCHDOG_TIMEOUT_SECS */

/* Semaphores */
K_SEM_DEFINE(lte_connected, 0, 1);    /* Semaphore to signal LTE connection established */
K_SEM_DEFINE(profile_received, 0, 1); /* Semaphore to signal profile received */

struct rx_buf_t {
	char *buf;
	size_t len;
	size_t pos;
};

static const struct device *const uart_dev = DEVICE_DT_GET(DT_NODELABEL(uart0));

/* Attach-attempt indicator: breathe the RGB LED's green channel (pwm-led1
 * alias, &pwm0 ch2, P0.31). Parent device and child index come from DT so a
 * devicetree reorder can't misaim the channel. */
static const struct device *const led_pwm = DEVICE_DT_GET(DT_PARENT(DT_ALIAS(pwm_led1)));
#define LED1_IDX DT_NODE_CHILD_IDX(DT_ALIAS(pwm_led1))

/* Breathe 0->100->0 over ~600 ms. ponytail: linear ramp, not gamma-corrected;
 * upgrade path is a small LUT if the fade looks uneven to the eye. */
#define BREATHE_STEPS	20
#define BREATHE_STEP_MS 30

static int breathe_step;
static void breathe_work_fn(struct k_work *work);
static K_WORK_DELAYABLE_DEFINE(breathe_work, breathe_work_fn);

/* Pure ramp, factored out so it can be self-checked on the host
 * (see tests/breathe_selfcheck.c). Returns <0 once the sequence is done. */
static int breathe_pct(int step)
{
	const int half = BREATHE_STEPS / 2;

	if (step < half) {
		return (step + 1) * 100 / half; /* ramp up: 10..100 */
	}
	if (step < BREATHE_STEPS) {
		return (BREATHE_STEPS - 1 - step) * 100 / half; /* ramp down: 90..0 */
	}
	return -1; /* sequence complete */
}

static void breathe_work_fn(struct k_work *work)
{
	int pct = breathe_pct(breathe_step++);

	if (pct < 0) {
		(void)led_set_brightness(led_pwm, LED1_IDX, 0);
		return;
	}

	(void)led_set_brightness(led_pwm, LED1_IDX, pct);
	k_work_reschedule(&breathe_work, K_MSEC(BREATHE_STEP_MS));
}

/* One breathe pulse per LTE attach attempt. Non-blocking (runs on the system
 * workqueue). ponytail: breathe_step races benignly with the workqueue if two
 * attempts overlap - worst case is one uneven ramp; a global lock is the upgrade. */
static void pulse_led1(void)
{
	if (!device_is_ready(led_pwm)) {
		return;
	}
	breathe_step = 0;
	k_work_reschedule(&breathe_work, K_NO_WAIT);
}

static void lte_handler(const struct lte_lc_evt *const evt)
{
	switch (evt->type) {
	case LTE_LC_EVT_NW_REG_STATUS:
		if ((evt->nw_reg_status != LTE_LC_NW_REG_REGISTERED_HOME) &&
		    (evt->nw_reg_status != LTE_LC_NW_REG_REGISTERED_ROAMING)) {
			break;
		}

		LOG_INF("Network registration status: %s",
			evt->nw_reg_status == LTE_LC_NW_REG_REGISTERED_HOME
				? "Connected - home network"
				: "Connected - roaming");
		k_sem_give(&lte_connected);
		break;
	case LTE_LC_EVT_RRC_UPDATE:
		LOG_INF("RRC mode: %s",
			evt->rrc_mode == LTE_LC_RRC_MODE_CONNECTED ? "Connected" : "Idle");
		break;
	case LTE_LC_EVT_CELL_UPDATE:
		LOG_INF("LTE cell changed: Cell ID: %d, Tracking area: %d", evt->cell.id,
			evt->cell.tac);
		break;
	default:
		break;
	}
}

static void modem_connect(void)
{
	pulse_led1(); /* attach attempt: initial connect + every full_modem_restart */
	int err = lte_lc_connect_async(lte_handler);
	if (err) {
		LOG_ERR("Connecting to LTE network failed, error: %d", err);
		return;
	}
}

/* Deepest restart short of a reboot: takes the whole modem library down and
 * back up, re-running the NRF_MODEM_LIB_ON_INIT SoftSIM hooks (SIM select,
 * handler registration) in addition to the UICC power cycle. Returns 0 when
 * the modem is up and reconnecting. */
static int full_modem_restart(void)
{
	int err;

	LOG_INF("Full modem library restart");

	(void)lte_lc_power_off();

	err = nrf_modem_lib_shutdown();
	if (err) {
		LOG_ERR("Modem library shutdown failed, error: %d", err);
	}

	err = nrf_modem_lib_init();
	if (err) {
		LOG_ERR("Modem library init failed, error: %d", err);
		return err;
	}

	modem_connect();

	return 0;
}

/* Block until registered or timeout, feeding the software watchdog. */
static bool wait_registered(void)
{
	for (int waited = 0; waited < CONNECT_TIMEOUT_SEC; waited += WATCHDOG_FEED_SLICE_SEC) {
		memfault_software_watchdog_feed();
		if (k_sem_take(&lte_connected, K_SECONDS(WATCHDOG_FEED_SLICE_SEC)) == 0) {
			return true;
		}
	}

	return false;
}

/* Stay online for the dwell period, feeding the software watchdog. Memfault
 * periodic upload/heartbeat traffic keeps flowing in the background. */
static void dwell_online(void)
{
	for (int slept = 0; slept < DWELL_ONLINE_SEC; slept += WATCHDOG_FEED_SLICE_SEC) {
		memfault_software_watchdog_feed();
		k_sleep(K_SECONDS(WATCHDOG_FEED_SLICE_SEC));
	}
}

/* Push whatever Memfault data is buffered (trace events, metrics, logs) to the
 * cloud. Coredump upload after a crash is handled internally by the NCS
 * integration (CONFIG_MEMFAULT_NCS_POST_COREDUMP_ON_NETWORK_CONNECTED);
 * everything else is also flushed periodically by
 * CONFIG_MEMFAULT_HTTP_PERIODIC_UPLOAD, so this only shortens the wait after a
 * (re)connect.
 */
static void memfault_post_on_connect(void)
{
#ifdef CONFIG_MEMFAULT_NCS_LTE_METRICS
	uint32_t time_to_lte_connection;

	memfault_metrics_heartbeat_timer_read(MEMFAULT_METRICS_KEY(ncs_lte_time_to_connect_ms),
					      &time_to_lte_connection);
	LOG_INF("Time to connect: %d ms", time_to_lte_connection);
#endif /* CONFIG_MEMFAULT_NCS_LTE_METRICS */

	if (IS_ENABLED(CONFIG_MEMFAULT_NCS_POST_COREDUMP_ON_NETWORK_CONNECTED) &&
	    memfault_coredump_has_valid_coredump(NULL)) {
		/* Coredump sending handled internally */
		return;
	}

	/* Close out the current heartbeat so metrics collected so far are sent. */
	memfault_metrics_heartbeat_debug_trigger();

	if (!memfault_packetizer_data_available()) {
		LOG_DBG("No Memfault data to send");
		return;
	}

	LOG_INF("Sending buffered data to Memfault");
	memfault_zephyr_port_post_data();
}

static void drain_logs_and_reboot(void)
{
	/* Flush the deferred log buffer over UART before the reboot discards it. */
	while (log_data_pending()) {
		log_process();
		k_yield();
	}
	sys_reboot(0);
}

void serial_cb(const struct device *dev, void *user_data)
{
	int rx_recv = 0;
	struct rx_buf_t *rx = (struct rx_buf_t *)user_data;
	char *rx_buf = rx->buf;
	size_t *rx_buf_pos = &rx->pos;

	if (!uart_irq_update(uart_dev)) {
		return;
	}

	while (uart_irq_rx_ready(uart_dev)) {
		rx_recv = uart_fifo_read(uart_dev, &rx_buf[*rx_buf_pos], 1);

		if ((rx_buf[*rx_buf_pos] == '\n') || (rx_buf[*rx_buf_pos] == '\r')) {
			rx_buf[*rx_buf_pos] = 0;
			k_sem_give(&profile_received);
			return;
		}

		*rx_buf_pos += rx_recv;
	}
}

static int provision_softsim_from_serial(void)
{
	if (!device_is_ready(uart_dev)) {
		LOG_ERR("UART device not found!");
		return -1;
	}

	char *profile = k_malloc(PROFILE_MAX_SIZE);
	__ASSERT_NO_MSG(profile != NULL);

	struct rx_buf_t rx = {
		.buf = profile,
		.len = PROFILE_MAX_SIZE,
		.pos = 0,
	};

	uart_irq_callback_user_data_set(uart_dev, serial_cb, &rx);
	uart_irq_rx_enable(uart_dev);

	do {
		LOG_INF("Transfer SoftSIM profile using serial COM port, terminate by "
			"newline character (return key)");
	} while (k_sem_take(&profile_received, K_SECONDS(20)));

	LOG_INF("Profile received: %zu characters in total", rx.pos);

	uart_irq_rx_disable(uart_dev);

	/* Provision the profile to the SoftSIM filesystem */
	if (nrf_softsim_provision((uint8_t *)profile, rx.pos) != 0) {
		LOG_ERR("SoftSIM Profile provisioning failed");
	}

	k_free(profile);

#ifndef CONFIG_SOFTSIM_FACTORY_RESET_ON_PROVISION
	/* Reboot to free the UART for the shell and bring the modem up cleanly
	 * with the new SIM. With factory reset enabled we must NOT reboot here:
	 * the modem is still uninitialised (AT commands return -NRF_EPERM, i.e.
	 * -1), so the reset waits until main() has called nrf_modem_lib_init() —
	 * see nrf_softsim_just_provisioned(). */
	drain_logs_and_reboot();
#endif /* !CONFIG_SOFTSIM_FACTORY_RESET_ON_PROVISION */

	return 0;
}

int main(void)
{
	LOG_INF("SoftSIM Memfault sample started.");

	if (!device_is_ready(led_pwm)) {
		LOG_WRN("LED PWM device not ready; attach indicator disabled");
	}

	if (!nrf_softsim_check_provisioned()) {
		if (provision_softsim_from_serial() != 0) {
			return -1;
		}
	}

	int32_t err = nrf_modem_lib_init();
	if (err) {
		LOG_ERR("Failed to initialize modem library, error: %d", err);
	}

#ifdef CONFIG_SOFTSIM_FACTORY_RESET_ON_PROVISION
	/* Modem is now initialised; if a profile was just provisioned (static or
	 * serial), wipe modem NVM and reboot so it comes up clean with the new SIM. */
	if (!err && nrf_softsim_just_provisioned()) {
		nrf_softsim_modem_factory_reset();
		drain_logs_and_reboot();
	}
#endif /* CONFIG_SOFTSIM_FACTORY_RESET_ON_PROVISION */

	/* ponytail: a hard fault with interrupts wedged escapes a software
	 * watchdog, but Memfault's fault handlers already cover hard faults;
	 * upgrade path is the hardware WDT. */
	memfault_software_watchdog_enable();

	modem_connect();

	LOG_INF("Waiting for LTE connect event.");

	/* Reconnect-churn soak loop: dwell online, then force a re-attach that
	 * power-cycles the UICC, forever. Cycle/failure stats land in the
	 * lte_churn_* heartbeat metrics; the SoftSIM lib's softsim_* metrics
	 * show the resulting UICC traffic. */
	int fail_streak = 0;

	for (uint32_t cycle = 0;; cycle++) {
		if (!wait_registered()) {
			LOG_ERR("Not registered within %d s", CONNECT_TIMEOUT_SEC);
			MEMFAULT_METRIC_ADD(lte_churn_fail_count, 1);
			MEMFAULT_TRACE_EVENT(lte_reattach_timeout);

			if (++fail_streak >= MAX_CONNECT_FAILURES) {
				LOG_ERR("%d consecutive attach failures, rebooting",
					fail_streak);
				drain_logs_and_reboot();
			}

			/* Recovery attempt doubles as the deep churn path. */
			full_modem_restart();
			continue;
		}

		fail_streak = 0;
		/* Started at the previous churn; errors out harmlessly on the
		 * first (boot) registration where no churn preceded it. */
		MEMFAULT_METRIC_TIMER_STOP(lte_churn_reattach_ms);
		MEMFAULT_METRIC_ADD(lte_churn_cycle_count, 1);

		LOG_INF("LTE connected! Churn cycle %u", cycle);
		memfault_post_on_connect();

		dwell_online();

		/* Churn: drop a stale registration signal, time the re-attach. */
		k_sem_reset(&lte_connected);
		MEMFAULT_METRIC_TIMER_START(lte_churn_reattach_ms);

		if ((cycle + 1) % CYCLES_PER_FULL_RESTART == 0) {
			full_modem_restart();
		} else {
			LOG_INF("Going offline (UICC off)");
			(void)lte_lc_offline(); /* CFUN=4: SoftSIM DEINIT */
			k_sleep(K_SECONDS(OFFLINE_HOLD_SEC));
			pulse_led1(); /* attach attempt: light-churn re-attach */
			(void)lte_lc_normal(); /* CFUN=1: SoftSIM INIT/ATR + re-attach */
		}
	}
}
```

## src/battery.c
```c
/*
 * SPDX-FileCopyrightText: Copyright (c) 2026 Onomondo ApS
 * SPDX-License-Identifier: GPL-3.0-only
 *
 * Battery state-of-charge for the Memfault battery metrics component,
 * read from the Thingy:91 ADP536x PMIC fuel gauge (enabled by the
 * board init in nrf/boards/nordic/thingy91/adp5360_init.c).
 */

#include <adp536x.h>
#include <memfault/metrics/platform/battery.h>
#include <zephyr/sys/util.h>

/* STATUS1 register, CHARGER_STATUS field: 0 means charger off. */
#define ADP536X_CHARGER_STATUS_MASK 0x07
#define ADP536X_CHARGER_OFF 0

int memfault_platform_get_stateofcharge(sMfltPlatformBatterySoc *soc)
{
	uint8_t pct;
	uint8_t status;

	if (adp536x_charger_status_1_read(&status)) {
		/* Discharging state must always be valid; without it, report failure
		 * and let Memfault skip this sample entirely.
		 */
		return -1;
	}

	soc->discharging = (status & ADP536X_CHARGER_STATUS_MASK) == ADP536X_CHARGER_OFF;

	if (adp536x_fg_soc(&pct)) {
		return -1;
	}

	/* Memfault expects the SoC pre-scaled (Zephyr port default scale: 1000). */
	soc->soc = MIN(pct, 100) * CONFIG_MEMFAULT_METRICS_BATTERY_SOC_PCT_SCALE_VALUE;

	return 0;
}
```

## src/fuel_gauge.c
```c
/*
 * SPDX-FileCopyrightText: Copyright (c) 2026 Onomondo ApS
 * SPDX-License-Identifier: GPL-3.0-only
 *
 * Battery state-of-charge for the Memfault battery metrics component,
 * read from the Thingy:91 X nPM1300 PMIC via the nRF Fuel Gauge library.
 *
 * On NCS >= 3.4 the application owns nrf_fuel_gauge_init()/process();
 * Memfault's nPM13xx port (memfault_platform_npm13xx_battery.c) only reads
 * SoC/SoH from the library and detects our init through --wrap.
 */

#include <zephyr/device.h>
#include <zephyr/drivers/sensor.h>
#include <zephyr/drivers/sensor/npm13xx_charger.h>
#include <zephyr/init.h>
#include <zephyr/kernel.h>
#include <zephyr/logging/log.h>
#include <zephyr/sys/__assert.h>
#include <zephyr/sys/util.h>

#include <nrf_fuel_gauge.h>
#include "lp803448_model.h"

LOG_MODULE_REGISTER(fuel_gauge);

/* ponytail: fixed 60 s cadence (the lib accepts irregular sampling); ceiling:
 * SOH estimation wants 2-5 Hz while charging, so battery_soh_pct hugs its
 * initial value. Upgrade path: shorten the period while the charger is active.
 */
#define SAMPLE_PERIOD K_SECONDS(60)

/* nPM13xx CHARGER.BCHGCHARGESTATUS register bitmasks */
#define NPM13XX_CHG_STATUS_COMPLETE_MASK BIT(1)
#define NPM13XX_CHG_STATUS_TRICKLE_MASK	 BIT(2)
#define NPM13XX_CHG_STATUS_CC_MASK	 BIT(3)
#define NPM13XX_CHG_STATUS_CV_MASK	 BIT(4)

static const struct device *charger = DEVICE_DT_GET(DT_NODELABEL(npm1300_charger));
static int64_t ref_time;

static int read_sensors(float *voltage, float *current, float *temp, int32_t *chg_status)
{
	struct sensor_value value;
	int ret;

	ret = sensor_sample_fetch(charger);
	if (ret < 0) {
		return ret;
	}

	sensor_channel_get(charger, SENSOR_CHAN_GAUGE_VOLTAGE, &value);
	*voltage = (float)value.val1 + ((float)value.val2 / 1000000);

	sensor_channel_get(charger, SENSOR_CHAN_GAUGE_TEMP, &value);
	*temp = (float)value.val1 + ((float)value.val2 / 1000000);

	sensor_channel_get(charger, SENSOR_CHAN_GAUGE_AVG_CURRENT, &value);
	*current = (float)value.val1 + ((float)value.val2 / 1000000);

	sensor_channel_get(charger, SENSOR_CHAN_NPM13XX_CHARGER_STATUS, &value);
	*chg_status = value.val1;

	return 0;
}

/* The secondary-cell library only lets SoC rise while it knows the battery is
 * charging, so charge-state updates are required for correctness.
 * ponytail: no VBUS/MFD callback - charge activity is learned from the status
 * register within one sample period; ceiling: TTF accuracy (unused here) and
 * CC vs CC_LIMITED disambiguation, so always report CC_LIMITED like the NCS
 * npm13xx_fuel_gauge sample does.
 */
static int charge_status_inform(int32_t chg_status)
{
	union nrf_fuel_gauge_ext_state_info_data state_info;

	if (chg_status & NPM13XX_CHG_STATUS_COMPLETE_MASK) {
		state_info.charge_state = NRF_FUEL_GAUGE_CHARGE_STATE_COMPLETE;
	} else if (chg_status & NPM13XX_CHG_STATUS_TRICKLE_MASK) {
		state_info.charge_state = NRF_FUEL_GAUGE_CHARGE_STATE_TRICKLE;
	} else if (chg_status & NPM13XX_CHG_STATUS_CC_MASK) {
		state_info.charge_state = NRF_FUEL_GAUGE_CHARGE_STATE_CC_LIMITED;
	} else if (chg_status & NPM13XX_CHG_STATUS_CV_MASK) {
		state_info.charge_state = NRF_FUEL_GAUGE_CHARGE_STATE_CV;
	} else {
		state_info.charge_state = NRF_FUEL_GAUGE_CHARGE_STATE_IDLE;
	}

	return nrf_fuel_gauge_ext_state_update(NRF_FUEL_GAUGE_EXT_STATE_INFO_CHARGE_STATE_CHANGE,
					       &state_info);
}

static void sample_work_handler(struct k_work *work)
{
	static int32_t chg_status_prev = -1;
	float voltage;
	float current;
	float temp;
	float soc;
	int32_t chg_status;
	int err;

	if (read_sensors(&voltage, &current, &temp, &chg_status) == 0) {
		if (chg_status != chg_status_prev) {
			chg_status_prev = chg_status;
			charge_status_inform(chg_status);
		}

		/* Zephyr sensor API convention for gauge current is
		 * negative=discharging, the lib expects negative=charging.
		 * ref_time only advances here, so a skipped iteration's time
		 * is included in the next successful t_delta.
		 */
		err = nrf_fuel_gauge_process(voltage, -current, temp,
					     (float)k_uptime_delta(&ref_time) / 1000.f, &soc, NULL);
		__ASSERT(err == 0 && soc >= 0.0f && soc <= 100.0f,
			 "fuel gauge broken: err=%d soc=%d", err, (int)soc);
	}

	k_work_schedule(k_work_delayable_from_work(work), SAMPLE_PERIOD);
}

static K_WORK_DELAYABLE_DEFINE(sample_work, sample_work_handler);

static int fuel_gauge_setup(void)
{
	struct nrf_fuel_gauge_init_parameters parameters =
		NRF_FUEL_GAUGE_DEFAULT_INIT_PARAMETERS_SECONDARY(0.0f, 0.0f, 0.0f, &battery_model);
	struct sensor_value value;
	int32_t chg_status;
	int err;

	if (!device_is_ready(charger)) {
		LOG_ERR("charger device not ready");
		return -ENODEV;
	}

	err = read_sensors(&parameters.v0, &parameters.i0, &parameters.t0, &chg_status);
	if (err < 0) {
		LOG_ERR("initial charger read failed (%d)", err);
		return err;
	}
	parameters.i0 = -parameters.i0;

	/* ponytail: no state persistence - SOH/cycle count reset each boot;
	 * upgrade path: nrf_fuel_gauge_state_get() + settings_save_one() as in
	 * the NCS npm13xx_fuel_gauge sample.
	 */
	err = nrf_fuel_gauge_init(&parameters, NULL);
	if (err < 0) {
		LOG_ERR("fuel gauge init failed (%d)", err);
		return err;
	}

	/* Charge current limit and termination current (limit/10) feed the
	 * charge/SOH modelling behind battery_soh_pct.
	 */
	sensor_channel_get(charger, SENSOR_CHAN_GAUGE_DESIRED_CHARGING_CURRENT, &value);
	float max_charge_current = (float)value.val1 + ((float)value.val2 / 1000000);

	nrf_fuel_gauge_ext_state_update(
		NRF_FUEL_GAUGE_EXT_STATE_INFO_CHARGE_CURRENT_LIMIT,
		&(union nrf_fuel_gauge_ext_state_info_data){
			.charge_current_limit = max_charge_current});
	nrf_fuel_gauge_ext_state_update(
		NRF_FUEL_GAUGE_EXT_STATE_INFO_TERM_CURRENT,
		&(union nrf_fuel_gauge_ext_state_info_data){
			.charge_term_current = max_charge_current / 10.f});
	charge_status_inform(chg_status);

	ref_time = k_uptime_get();
	k_work_schedule(&sample_work, SAMPLE_PERIOD);

	LOG_INF("nRF Fuel Gauge %s, model %s", nrf_fuel_gauge_version, battery_model.name);

	return 0;
}

/* One priority before Memfault's own SYS_INIT (default 40) so the boot-time
 * SoC read that seeds the discharge session succeeds. All nPM1300 devices
 * init at POST_KERNEL, i.e. before any APPLICATION-level init.
 */
SYS_INIT(fuel_gauge_setup, APPLICATION, CONFIG_MEMFAULT_NRF_PLATFORM_BATTERY_NPM13XX_INIT_PRIORITY);
```
